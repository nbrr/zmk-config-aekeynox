## config/boards/shields/my_cirque_trackpad/Kconfig.defconfig
```kconfig
# Copyright (c) 2022 The ZMK Contributors
# SPDX-License-Identifier: MIT

if MY_SHIELD_CIRQUE_TRACKPAD

config ZMK_POINTING
    default y

config SPI
    default y

endif
```

## config/boards/shields/my_cirque_trackpad/Kconfig.shield
```kconfig
# Copyright (c) 2022 The ZMK Contributors
# SPDX-License-Identifier: MIT

config MY_SHIELD_CIRQUE_TRACKPAD
    def_bool $(shields_list_contains,my_cirque_trackpad)
```
